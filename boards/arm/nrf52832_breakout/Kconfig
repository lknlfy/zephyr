## boards/arm/nrf52832_breakout/Kconfig.board
```kconfig
# Kconfig - nRF52 PCA10040 board configuration
#
# Copyright (c) 2016 Nordic Semiconductor ASA
#
# SPDX-License-Identifier: Apache-2.0

config  BOARD_NRF52832_BREAKOUT
	bool "nRF52832 breakout"
	depends on SOC_NRF52832_QFAA
```

## boards/arm/nrf52832_breakout/Kconfig.defconfig
```kconfig
# Kconfig - nRF52 PCA10040 board configuration
#
# Copyright (c) 2016 Nordic Semiconductor ASA
#
# SPDX-License-Identifier: Apache-2.0

if BOARD_NRF52832_BREAKOUT

config BOARD
	default "nrf52832_breakout"

endif # BOARD_NRF52832_BREAKOUT
```

## boards/arm/stm32f103c8_breakout/Kconfig.board
```kconfig
# Kconfig - STM32 Minimum Development Board Configuration
#
# Copyright (c) 2017, embedjournal.com
#
# SPDX-License-Identifier: Apache-2.0
#
config BOARD_STM32F103C8_BREAKOUT
	bool "STM32F103C8 Minimum Development Board"
	depends on SOC_STM32F103X8
```

## boards/arm/stm32f103c8_breakout/Kconfig.defconfig
```kconfig
# Kconfig - STM32 Minimum Development Board Configuration
#
# Copyright (c) 2017, embedjournal.com
#
# SPDX-License-Identifier: Apache-2.0
#

if BOARD_STM32F103C8_BREAKOUT

config BOARD
	default "stm32f103c8_breakout"

if UART_CONSOLE

config UART_STM32_PORT_1
	default y

endif # UART_CONSOLE

endif # BOARD_STM32F103C8_BREAKOUT
```
